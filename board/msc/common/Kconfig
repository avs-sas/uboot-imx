## board/msc/common/Kconfig
```kconfig
#
# Copyright (C) 2019 AVNET Integrated, MSC Technologies GmbH
#
# SPDX-License-Identifier:      GPL-2.0+
#

menu "MSC board/module specific features"

config BOARDINFO_EEPROM
	bool "Board information EEPROM storage"
	default y
	help
	  Enable board information storage in EEPROM
```

## board/msc/sm2s_imx8mm/Kconfig
```kconfig
if TARGET_MSC_SM2S_IMX8MM

config SYS_BOARD
	default "sm2s_imx8mm"

config SYS_VENDOR
	default "msc"

config SYS_CONFIG_NAME
	default "msc_sm2s_imx8mm"

config IMX_CONFIG
	default "board/msc/sm2s_imx8mm/imximage-8mm.cfg"

config IMX8M_1G_MEMORY
	bool "imx8m 1GB memory size"

endif
```
